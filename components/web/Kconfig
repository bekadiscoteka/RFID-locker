## components/web/Kconfig
```kconfig
menu "RFID web UI"

    config APP_ADMIN_PASSWORD
        string "Admin password"
        default ""
        help
            Needed to add, rename or remove cards from the web page.
            Leave empty to make the card list read-only on the web.
            Stored in sdkconfig, which is not committed.

endmenu
```

## components/wifi/Kconfig
```kconfig
menu "WiFi station"

    config APP_WIFI_SSID
        string "Network name (SSID)"
        default ""
        help
            2.4 GHz network to join. The ESP32 can't see 5 GHz networks.

    config APP_WIFI_PASSWORD
        string "Password"
        default ""
        help
            WPA2 password. Stored in sdkconfig, which is not committed.

endmenu
```
